## config/west.yml
```yaml
manifest:
  remotes:
    - name: zmkfirmware
      url-base: https://github.com/zmkfirmware
    - name: urob
      url-base: https://github.com/urob
    # YADS
    - name: janpfischer
      url-base: https://github.com/janpfischer
    # Prospector
    # - name: carrefinho
    #   url-base: https://github.com/carrefinho
  projects:
    - name: zmk
      remote: zmkfirmware
      revision: v0.3
      import: app/west.yml
    - name: zmk-dongle-screen
      remote: janpfischer
      revision: main
    # Prospector
    # - name: prospector-zmk-module
    #   remote: carrefinho
    #   revision: main

    - name: zmk-auto-layer
      remote: urob
      revision: v0.3 # set to same version as zmk above
  self:
    path: config
```
